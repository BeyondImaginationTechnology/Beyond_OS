## beyond-os-desktop/core/Config.in
```kconfig
menu "Beyond Imagination OS Core"
source "$BR2_EXTERNAL_BEYOND_CORE_PATH/package/beyond-core/Config.in"
source "$BR2_EXTERNAL_BEYOND_CORE_PATH/package/beyond-creator/Config.in"
source "$BR2_EXTERNAL_BEYOND_CORE_PATH/package/beyond-academy/Config.in"
source "$BR2_EXTERNAL_BEYOND_CORE_PATH/package/beyond-profile/Config.in"
endmenu
```

## beyond-os-desktop/core/package/beyond-academy/Config.in
```kconfig
config BR2_PACKAGE_BEYOND_ACADEMY
	bool "Beyond Imagination OS Academy Learning Hub"
	depends on BR2_PACKAGE_SDL2
	depends on BR2_PACKAGE_SDL2_TTF
	depends on BR2_PACKAGE_SDL2_X11
	help
	  Native Academy learning workspace with local course folders, a focus
	  session and visible student/teacher boundaries.
```

## beyond-os-desktop/core/package/beyond-core/Config.in
```kconfig
config BR2_PACKAGE_BEYOND_CORE
	bool "Beyond Imagination OS Core desktop"
	depends on BR2_PACKAGE_SDL2
	depends on BR2_PACKAGE_SDL2_TTF
	depends on BR2_PACKAGE_SDL2_X11
	help
	  Native Core shell and framebuffer startup screen for Beyond Imagination OS.
```

## beyond-os-desktop/core/package/beyond-creator/Config.in
```kconfig
config BR2_PACKAGE_BEYOND_CREATOR
	bool "BIT OS Creator Hub"
	depends on BR2_PACKAGE_SDL2
	depends on BR2_PACKAGE_SDL2_TTF
	depends on BR2_PACKAGE_SDL2_X11
	help
	  Native workspace setup, app chooser, Beyond Music and Beyond Wallpapers
	  experience for BIT OS Creator 0.1.
```

## beyond-os-desktop/core/package/beyond-gaming/Config.in
```kconfig
config BR2_PACKAGE_BEYOND_GAMING
	bool "Beyond Imagination OS Gaming Hub"
	depends on BR2_PACKAGE_SDL2
	depends on BR2_PACKAGE_SDL2_TTF
	depends on BR2_PACKAGE_SDL2_X11
	help
	  Native Gaming Hub with controller detection, saved play preferences,
	  and a bundled local arcade game.
```

## beyond-os-desktop/core/package/beyond-profile/Config.in
```kconfig
config BR2_PACKAGE_BEYOND_PROFILE
	bool "Beyond Imagination OS flavour profile"
	default y
	help
	  Installs the selected Beyond Imagination OS flavour manifest.

config BR2_BEYOND_PROFILE_ID
	string "Beyond Imagination OS flavour ID"
	default "core"
	depends on BR2_PACKAGE_BEYOND_PROFILE
	help
	  The flavour ID written into the image metadata.
```

## beyond-os-desktop/core/package/beyond-sentinel/Config.in
```kconfig
config BR2_PACKAGE_BEYOND_SENTINEL
	bool "Beyond Imagination OS Sentinel Console"
	depends on BR2_PACKAGE_SDL2
	depends on BR2_PACKAGE_SDL2_TTF
	depends on BR2_PACKAGE_SDL2_X11
	help
	  Native Sentinel console for local device posture, policy choices,
	  audit-report folders and future opt-in fleet enrollment.
```

## beyond-os-desktop/cyber/Config.in
```kconfig
menu "BIT OS Cyber"
source "$BR2_EXTERNAL_BEYOND_CYBER_PATH/package/beyond-cyber/Config.in"
endmenu
```

## beyond-os-desktop/cyber/configs/beyond_cyber_x86_64_defconfig
```kconfig
BR2_x86_64=y
BR2_TOOLCHAIN_BUILDROOT_MUSL=y
BR2_TOOLCHAIN_BUILDROOT_CXX=y
BR2_INSTALL_LIBSTDCPP=y
BR2_PACKAGE_HOST_LINUX_HEADERS_CUSTOM_6_18=y
BR2_GLOBAL_PATCH_DIR="board/qemu/patches"
BR2_DOWNLOAD_FORCE_CHECK_HASHES=y
BR2_TARGET_GENERIC_HOSTNAME="beyond-cyber"
BR2_TARGET_GENERIC_ISSUE="BIT OS Cyber Edition 1.0 (Development)"
# BR2_TARGET_ENABLE_ROOT_LOGIN is not set
# BR2_TARGET_GENERIC_GETTY is not set
BR2_ROOTFS_DEVICE_CREATION_DYNAMIC_EUDEV=y
BR2_SYSTEM_DHCP="eth0"
BR2_ROOTFS_USERS_TABLES="$(BR2_EXTERNAL_BEYOND_CYBER_PATH)/board/x86_64/users.txt"
BR2_ROOTFS_OVERLAY="$(BR2_EXTERNAL_BEYOND_CYBER_PATH)/overlay"
BR2_ROOTFS_POST_BUILD_SCRIPT="$(BR2_EXTERNAL_BEYOND_CYBER_PATH)/board/x86_64/post-build.sh"
BR2_LINUX_KERNEL=y
BR2_LINUX_KERNEL_CUSTOM_VERSION=y
BR2_LINUX_KERNEL_CUSTOM_VERSION_VALUE="6.18.7"
BR2_LINUX_KERNEL_USE_CUSTOM_CONFIG=y
BR2_LINUX_KERNEL_CUSTOM_CONFIG_FILE="board/qemu/x86_64/linux.config"
BR2_LINUX_KERNEL_CONFIG_FRAGMENT_FILES="$(BR2_EXTERNAL_BEYOND_CYBER_PATH)/board/x86_64/linux.fragment $(BR2_EXTERNAL_BEYOND_CYBER_PATH)/board/x86_64/cyber-security.fragment"
BR2_LINUX_KERNEL_NEEDS_HOST_LIBELF=y
BR2_PACKAGE_XORG7=y
BR2_PACKAGE_XSERVER_XORG_SERVER=y
BR2_PACKAGE_XSERVER_XORG_SERVER_MODULAR=y
BR2_PACKAGE_XDRIVER_XF86_VIDEO_FBDEV=y
BR2_PACKAGE_XDRIVER_XF86_INPUT_LIBINPUT=y
BR2_PACKAGE_XAPP_XINIT=y
BR2_PACKAGE_XAPP_XAUTH=y
BR2_PACKAGE_XTERM=y
BR2_PACKAGE_OPENBOX=y
BR2_PACKAGE_SDL2=y
BR2_PACKAGE_SDL2_X11=y
BR2_PACKAGE_SDL2_TTF=y
BR2_PACKAGE_DEJAVU=y
BR2_PACKAGE_DEJAVU_SANS=y
BR2_PACKAGE_CA_CERTIFICATES=y
BR2_PACKAGE_NFTABLES=y
BR2_PACKAGE_BEYOND_CYBER=y
BR2_TARGET_ROOTFS_EXT2=y
BR2_TARGET_ROOTFS_EXT2_4=y
BR2_TARGET_ROOTFS_EXT2_SIZE="512M"
BR2_TARGET_ROOTFS_EXT2_LABEL="BEYOND_CYBER"
# BR2_TARGET_ROOTFS_TAR is not set
```

## beyond-os-desktop/cyber/package/beyond-cyber/Config.in
```kconfig
config BR2_PACKAGE_BEYOND_CYBER
	bool "BIT OS Cyber desktop"
	depends on BR2_PACKAGE_SDL2
	depends on BR2_PACKAGE_SDL2_TTF
	depends on BR2_PACKAGE_SDL2_X11
	help
	  Native Cyber shell and framebuffer startup screen for BIT OS.
```

## beyond-os-desktop/home/Config.in
```kconfig
menu "Beyond OS Home"
source "$BR2_EXTERNAL_BEYOND_HOME_PATH/package/beyond-home/Config.in"
endmenu
```

## beyond-os-desktop/home/configs/beyond_home_uefi_installer_x86_64_defconfig
```kconfig
BR2_x86_64=y
BR2_TOOLCHAIN_BUILDROOT_MUSL=y
BR2_TOOLCHAIN_BUILDROOT_CXX=y
BR2_INSTALL_LIBSTDCPP=y
BR2_PACKAGE_HOST_LINUX_HEADERS_CUSTOM_6_18=y
BR2_GLOBAL_PATCH_DIR="board/qemu/patches"
BR2_DOWNLOAD_FORCE_CHECK_HASHES=y
BR2_TARGET_GENERIC_HOSTNAME="beyond-home"
BR2_TARGET_GENERIC_ISSUE="Beyond OS Home Edition 1.0 (Installer Candidate)"
# BR2_TARGET_ENABLE_ROOT_LOGIN is not set
# BR2_TARGET_GENERIC_GETTY is not set
BR2_ROOTFS_DEVICE_CREATION_DYNAMIC_EUDEV=y
BR2_SYSTEM_DHCP="eth0"
BR2_ROOTFS_USERS_TABLES="$(BR2_EXTERNAL_BEYOND_HOME_PATH)/board/x86_64/users.txt"
BR2_ROOTFS_OVERLAY="$(BR2_EXTERNAL_BEYOND_HOME_PATH)/overlay"
BR2_ROOTFS_POST_BUILD_SCRIPT="$(BR2_EXTERNAL_BEYOND_HOME_PATH)/board/x86_64/post-build.sh"
BR2_ROOTFS_POST_IMAGE_SCRIPT="$(BR2_EXTERNAL_BEYOND_HOME_PATH)/board/x86_64/post-image-uefi.sh"
BR2_ROOTFS_POST_SCRIPT_ARGS="$(BR2_DEFCONFIG)"
BR2_LINUX_KERNEL=y
BR2_LINUX_KERNEL_CUSTOM_VERSION=y
BR2_LINUX_KERNEL_CUSTOM_VERSION_VALUE="6.18.7"
BR2_LINUX_KERNEL_USE_CUSTOM_CONFIG=y
BR2_LINUX_KERNEL_CUSTOM_CONFIG_FILE="board/qemu/x86_64-efi/linux.config"
BR2_LINUX_KERNEL_CONFIG_FRAGMENT_FILES="$(BR2_EXTERNAL_BEYOND_HOME_PATH)/board/x86_64/linux.fragment $(BR2_EXTERNAL_BEYOND_HOME_PATH)/board/x86_64/installer-linux.fragment"
BR2_LINUX_KERNEL_NEEDS_HOST_OPENSSL=y
BR2_LINUX_KERNEL_NEEDS_HOST_LIBELF=y
BR2_PACKAGE_XORG7=y
BR2_PACKAGE_XSERVER_XORG_SERVER=y
BR2_PACKAGE_XSERVER_XORG_SERVER_MODULAR=y
BR2_PACKAGE_XDRIVER_XF86_VIDEO_FBDEV=y
BR2_PACKAGE_XDRIVER_XF86_INPUT_LIBINPUT=y
BR2_PACKAGE_XAPP_XINIT=y
BR2_PACKAGE_XAPP_XAUTH=y
BR2_PACKAGE_XTERM=y
BR2_PACKAGE_OPENBOX=y
BR2_PACKAGE_SDL2=y
BR2_PACKAGE_SDL2_X11=y
BR2_PACKAGE_SDL2_TTF=y
BR2_PACKAGE_DEJAVU=y
BR2_PACKAGE_DEJAVU_SANS=y
BR2_PACKAGE_E2FSPROGS=y
BR2_PACKAGE_E2FSPROGS_RESIZE2FS=y
BR2_PACKAGE_DOSFSTOOLS=y
BR2_PACKAGE_DOSFSTOOLS_MKFS_FAT=y
BR2_PACKAGE_UTIL_LINUX=y
BR2_PACKAGE_UTIL_LINUX_BINARIES=y
BR2_PACKAGE_EFIBOOTMGR=y
BR2_PACKAGE_BEYOND_HOME=y
BR2_TARGET_ROOTFS_EXT2=y
BR2_TARGET_ROOTFS_EXT2_4=y
BR2_TARGET_ROOTFS_EXT2_SIZE="2048M"
BR2_TARGET_ROOTFS_EXT2_LABEL="BEYOND_HOME"
# BR2_TARGET_ROOTFS_TAR is not set
BR2_TARGET_GRUB2=y
BR2_TARGET_GRUB2_X86_64_EFI=y
BR2_TARGET_GRUB2_BUILTIN_CONFIG="$(BR2_EXTERNAL_BEYOND_HOME_PATH)/board/x86_64/grub-iso-efi.cfg"
BR2_TARGET_GRUB2_BUILTIN_MODULES_EFI="boot linux normal configfile iso9660 part_gpt fat ext2"
BR2_PACKAGE_HOST_DOSFSTOOLS=y
BR2_PACKAGE_HOST_GENIMAGE=y
BR2_PACKAGE_HOST_MTOOLS=y
BR2_TARGET_ROOTFS_ISO9660=y
# BR2_TARGET_ROOTFS_ISO9660_INITRD is not set
BR2_TARGET_ROOTFS_ISO9660_GRUB2=y
BR2_TARGET_ROOTFS_ISO9660_BOOT_MENU="$(BR2_EXTERNAL_BEYOND_HOME_PATH)/board/x86_64/grub-iso.cfg"
```

## beyond-os-desktop/home/package/beyond-home/Config.in
```kconfig
config BR2_PACKAGE_BEYOND_HOME
	bool "Beyond OS Home desktop"
	depends on BR2_PACKAGE_SDL2
	depends on BR2_PACKAGE_SDL2_TTF
	depends on BR2_PACKAGE_SDL2_X11
	help
	  Native Home shell and framebuffer startup screen for Beyond OS.
```
